## src/arch/cortex-a9/phovena.its
```
/dts-v1/;

/ {
  description = "phovena OS kernel image";
  #address-cells = <1>;

  images {
  	 kernel@1 {
	 	  data = /incbin/("kernel-cortex-a9.bin");
		  type = "kernel";
		  arch = "arm";
		  os = "u-boot";
		  compression = "none";
		  load = <0x80000000>;
		  entry = <0x80000000>;

		  };
		  };
		  };
		 
```
